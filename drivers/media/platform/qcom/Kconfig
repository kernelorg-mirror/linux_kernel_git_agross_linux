## drivers/media/platform/qcom/Kconfig
```kconfig
comment "Qualcomm V4L2 drivers"

source "drivers/media/platform/qcom/vidc/Kconfig"
```

## drivers/media/platform/qcom/vidc/Kconfig
```kconfig
menuconfig QCOM_VIDC
	tristate "Qualcomm V4L2 encoder/decoder driver"
	depends on ARCH_QCOM && VIDEO_V4L2
	depends on IOMMU_DMA
	depends on QCOM_VENUS_PIL
	select VIDEOBUF2_DMA_SG
```
